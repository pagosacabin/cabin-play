// ---------------------------------------------------------------------------
//  ramp_screen.h -- the diagnostic ramp screen, drawing code shared by the
//  firmware (src/main.cpp) and by tools/host_render.cpp on the host.
//
//  COPIED VERBATIM from photo-display-64/src/ramp_screen.h (rung 2) for task
//  0179, with exactly one edit: the include of photo_render64.h became
//  ladder64.h, because this rung has no on-device JPEG decoder. This file is
//  C++ (rung 2 built it from main.cpp), so this project's firmware and its
//  host render tool are C++ too. No coordinate, level or written byte differs;
//  tools/host_render.cpp proves it by byte-comparing its render against the
//  committed rung-2 ramp preview. The layout,
//  coordinates, font and raw packing are untouched, so a photograph of this
//  rung's ramp means the same thing as rung 2's. tools/host_render.cpp proves
//  the copy is faithful by byte-comparing its render against the committed
//  photo-display-64/tools/ramp-preview.ppm (see README.md).
//
//  Why a shared header: the ramp is the one screen whose *purpose* is to be
//  photographed and judged, and nobody can see it from this machine. Keeping
//  the layout in one place means the committed preview (tools/ramp-preview.png)
//  is generated by the same code the board runs -- only the pixel sink differs
//  -- instead of being a hand-drawn mock-up that could drift from the firmware.
//
//  LAYOUT (320x240):
//      y  14.. 53   R row: 4 patches, order 0 / LSB only / MSB only / both
//      y  60.. 99   G row: same order
//      y 106..145   B row: same order
//      y 146..185   W row: the same four levels on all three channels at once
//                   (grey ramp -- where a per-channel fault shows as a tint)
//      y 200..239   horizontal black->white gradient, dithered by the same
//                   quantiser the photos use (banding here = too few
//                   thresholds; a clean sweep = the dither works)
//
//  Patches are 60 px wide with 4 px black gutters so the left-to-right order
//  stays unambiguous in a photograph, and each row carries its channel letter
//  (R/G/B/W) at the left, drawn from the 5x7 font below at 3x.
//
//  The pixel sink takes the *raw* pixel byte the controller would write, so the
//  host preview and the board both exercise the same level->raw mapping (the
//  caller supplies the LUT: FabGL's createRawPixel on the board, the ladder
//  table on the host).
// ---------------------------------------------------------------------------
#pragma once

#include <stdint.h>
#include "ladder64.h"

typedef void (*RampPutFn)(void *ctx, int x, int y, uint8_t raw);

// A 5x7 bitmap font: only the glyphs this screen needs (R G B W 0 1 2 3).
// Each row is a 5-bit mask, bit 4 = leftmost column.
struct RampGlyph { char c; uint8_t row[7]; };
static const RampGlyph RAMP_FONT[] = {
    { 'R', {0x1E, 0x11, 0x11, 0x1E, 0x14, 0x12, 0x11} },
    { 'G', {0x0E, 0x11, 0x10, 0x13, 0x11, 0x11, 0x0E} },
    { 'B', {0x1E, 0x11, 0x11, 0x1E, 0x11, 0x11, 0x1E} },
    { 'W', {0x11, 0x11, 0x11, 0x15, 0x15, 0x1B, 0x11} },
    { '0', {0x0E, 0x11, 0x13, 0x15, 0x19, 0x11, 0x0E} },
    { '1', {0x04, 0x0C, 0x04, 0x04, 0x04, 0x04, 0x0E} },
    { '2', {0x0E, 0x11, 0x01, 0x02, 0x04, 0x08, 0x1F} },
    { '3', {0x1F, 0x02, 0x04, 0x02, 0x01, 0x11, 0x0E} },
};

static const int RAMP_ROWS[3] = {14, 60, 106};
static const int RAMP_H     = 40;
static const int RAMP_X0    = 48;
static const int RAMP_PITCH = 64;
static const int RAMP_PATCH_W = 60;
static const int RAMP_GREY_Y = 146;
static const int RAMP_GRAD_Y = 200;
static const int RAMP_GRAD_H = 40;

// raw index = (B<<4)|(G<<2)|R with each field 0..3 -- the same packing the
// photo path uses, so the ramp and the photos agree about what level 2 is.
static inline uint8_t rampRaw(int qr, int qg, int qb)
{
    return (uint8_t)((qb << 4) | (qg << 2) | qr);
}

static inline void rampFill(RampPutFn put, void *ctx, int x, int y, int w, int h, uint8_t raw)
{
    for (int j = 0; j < h; j++)
        for (int i = 0; i < w; i++)
            put(ctx, x + i, y + j, raw);
}

static inline void rampChar(RampPutFn put, void *ctx, char ch, int x, int y, int scale, uint8_t raw)
{
    for (unsigned k = 0; k < sizeof(RAMP_FONT) / sizeof(RAMP_FONT[0]); k++) {
        const RampGlyph &g = RAMP_FONT[k];
        if (g.c != ch) continue;
        for (int r = 0; r < 7; r++)
            for (int c = 0; c < 5; c++)
                if (g.row[r] & (0x10 >> c))
                    rampFill(put, ctx, x + c * scale, y + r * scale, scale, scale, raw);
        return;
    }
}

// Draw the whole screen. hres/vres let the same code render a different
// geometry on the host, but the firmware passes 320x240 and the layout above
// assumes it.
static inline void rampDraw(RampPutFn put, void *ctx, int hres, int vres)
{
    rampFill(put, ctx, 0, 0, hres, vres, rampRaw(0, 0, 0));

    const char labels[3] = { 'R', 'G', 'B' };
    for (int ch = 0; ch < 3; ch++) {
        const int y = RAMP_ROWS[ch];
        rampChar(put, ctx, labels[ch], 4, y + 10, 3, rampRaw(3, 3, 3));
        for (int q = 0; q < 4; q++) {
            const int x = RAMP_X0 + q * RAMP_PITCH;
            uint8_t raw = ch == 0 ? rampRaw(q, 0, 0)
                        : ch == 1 ? rampRaw(0, q, 0)
                                  : rampRaw(0, 0, q);
            rampFill(put, ctx, x, y, RAMP_PATCH_W, RAMP_H, raw);
        }
    }

    // Combined grey ramp: all three channels at the same level.
    rampChar(put, ctx, 'W', 4, RAMP_GREY_Y + 10, 3, rampRaw(3, 3, 3));
    for (int q = 0; q < 4; q++)
        rampFill(put, ctx, RAMP_X0 + q * RAMP_PITCH, RAMP_GREY_Y, RAMP_PATCH_W, RAMP_H,
                 rampRaw(q, q, q));

    // Smooth gradient: a horizontal black->white ramp quantised and dithered by
    // the same code the photos use, so a photograph of this band shows what the
    // dither does to a smooth surface.
    for (int x = 0; x < hres; x++) {
        const int v = (x * 255) / (hres - 1);
        for (int y = 0; y < RAMP_GRAD_H; y++) {
            const int q = photo64Quant((uint8_t)v, BAYER8[y & 7][x & 7],
                                       PHOTO64_MODE_PERCEPTUAL);
            put(ctx, x, RAMP_GRAD_Y + y, rampRaw(q, q, q));
        }
    }
}
