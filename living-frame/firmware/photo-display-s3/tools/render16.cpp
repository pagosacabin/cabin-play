// ---------------------------------------------------------------------------
//  tools/render16.c -- host-side render of the rung 3b (0180) portrait ramp.
//
//  Compiles the SAME header the firmware compiles (src/ramp_portrait.h, via
//  src/ramp_palette.h and src/ladder64.h) and fills a 640x480 4bpp raster with
//  palette indices exactly as src/main.cpp's fb_put_index does, so the preview
//  committed to tools/ is generated by the board's own drawing code -- only the
//  pixel sink differs. Two outputs:
//
//    ramp-portrait-raster.ppm   the 640x480 landscape raster as scanned out
//    ramp-portrait.ppm          the same frame rotated back up, i.e. what
//                               Stephen sees on a monitor pivoted 90 deg
//                               counter-clockwise (rotate-left)
//
//  It also reads the raster back at every patch centre and prints the palette
//  INDEX found there against the index the layout calls for. That is the check
//  that the portrait canvas -> landscape raster mapping is wired the right way
//  round: a transposed or mirrored mapping lands a different index under the
//  probe, and the test fails loudly instead of shipping a rotated preview.
//
//  Build: g++ -O2 -Isrc tools/render16.cpp -o /tmp/render16 -lm
//  Run  : /tmp/render16 tools
// ---------------------------------------------------------------------------
#include <stdio.h>
#include <stdlib.h>
#include <string.h>

#include "ramp_portrait.h"
#include "ramp_palette.h"

#define LW RP_LW
#define LH RP_LH

static uint8_t g_fb[LW * LH / 2];
static uint8_t g_code[4];

static void fbPutIndex(void *ctx, int lx, int ly, uint8_t idx)
{
    (void)ctx;
    if ((unsigned)lx >= LW || (unsigned)ly >= LH) return;
    const int byte = ly * (LW / 2) + (lx >> 1);
    const uint8_t v = g_fb[byte];
    g_fb[byte] = (lx & 1) ? (uint8_t)((v & 0x0F) | (idx << 4))
                          : (uint8_t)((v & 0xF0) | (idx & 0x0F));
}

static int getIndex(int lx, int ly)
{
    const uint8_t v = g_fb[ly * (LW / 2) + (lx >> 1)];
    return (lx & 1) ? (v >> 4) : (v & 0x0F);
}

static void rgbOf(uint8_t raw, int *r, int *g, int *b)
{
    *r = g_code[raw & 3];
    *g = g_code[(raw >> 2) & 3];
    *b = g_code[(raw >> 4) & 3];
}

static int writeRaster(const char *path)
{
    FILE *o = fopen(path, "wb");
    if (!o) { perror(path); return 2; }
    fprintf(o, "P6\n%d %d\n255\n", LW, LH);
    uint8_t *line = (uint8_t *)malloc((size_t)LW * 3);
    for (int y = 0; y < LH; y++) {
        for (int x = 0; x < LW; x++) {
            int r, g, b;
            rgbOf(RAMP_PAL[getIndex(x, y)], &r, &g, &b);
            line[x * 3 + 0] = (uint8_t)r;
            line[x * 3 + 1] = (uint8_t)g;
            line[x * 3 + 2] = (uint8_t)b;
        }
        fwrite(line, 1, (size_t)LW * 3, o);
    }
    free(line);
    fclose(o);
    printf("wrote %s (%dx%d, landscape raster as scanned out)\n", path, LW, LH);
    return 0;
}

// Rotate the raster back up into the portrait view: portrait(xp,yp) is
// raster(LW-1-yp, xp), so the inverse read is raster(x = LW-1-yp, y = xp).
static int writePortrait(const char *path)
{
    FILE *o = fopen(path, "wb");
    if (!o) { perror(path); return 2; }
    fprintf(o, "P6\n%d %d\n255\n", RP_PW, RP_PH);
    uint8_t *line = (uint8_t *)malloc((size_t)RP_PW * 3);
    for (int yp = 0; yp < RP_PH; yp++) {
        for (int xp = 0; xp < RP_PW; xp++) {
            int r, g, b;
            const int lx = RP_LW - 1 - yp, ly = xp;
            rgbOf(RAMP_PAL[getIndex(lx, ly)], &r, &g, &b);
            line[xp * 3 + 0] = (uint8_t)r;
            line[xp * 3 + 1] = (uint8_t)g;
            line[xp * 3 + 2] = (uint8_t)b;
        }
        fwrite(line, 1, (size_t)RP_PW * 3, o);
    }
    free(line);
    fclose(o);
    printf("wrote %s (%dx%d, portrait view: monitor pivoted counter-clockwise)\n",
           path, RP_PW, RP_PH);
    return 0;
}

int main(int argc, char **argv)
{
    const char *dir = argc > 1 ? argv[1] : "tools";
    char path[512];

    ladderInit();
    ladderLevelBytes(g_code);
    printf("level sRGB codes: %d %d %d %d\n", g_code[0], g_code[1], g_code[2], g_code[3]);

    memset(g_fb, 0, sizeof(g_fb));
    rampPortraitDraw(fbPutIndex, NULL);

    // --- patch index probe ---------------------------------------------------
    int failures = 0;
    const char *labels = "RGBW";
    printf("patch centres read back from the raster (index expected -> found):\n");
    for (int row = 0; row < 4; row++) {
        const int yp = RP_ROW_Y[row] + RP_ROW_H / 2;
        printf("  row %c:", labels[row]);
        for (int q = 0; q < 4; q++) {
            const int xp = RP_PATCH_X0 + q * RP_PATCH_PITCH + RP_PATCH_W / 2;
            const int lx = rpMapX(xp, yp), ly = rpMapY(xp, yp);
            const int expect = row < 3 ? row * 4 + q : rpGreyIndex(q);
            const int found = getIndex(lx, ly);
            printf(" [%dx%d] %2d->%2d", xp, yp, expect, found);
            if (expect != found) failures++;
        }
        printf("\n");
    }

    // Gradient ends: black at the left, white at the right.
    const int yg = RP_GRAD_Y + RP_GRAD_H / 2;
    const int i0 = getIndex(rpMapX(0, yg), rpMapY(0, yg));
    const int i1 = getIndex(rpMapX(RP_PW - 1, yg), rpMapY(RP_PW - 1, yg));
    printf("gradient band ends: index %d (left) .. %d (right)  %s\n", i0, i1,
           (i0 == RP_I_BLACK && i1 == RP_I_GREY3) ? "OK" : "UNEXPECTED");
    if (!(i0 == RP_I_BLACK && i1 == RP_I_GREY3)) failures++;

    // Every index the ramp uses must be inside the 16-entry palette.
    int used[16] = {0};
    for (int y = 0; y < LH; y++)
        for (int x = 0; x < LW; x++)
            used[getIndex(x, y)]++;
    printf("indices used:");
    int distinct = 0;
    for (int i = 0; i < 16; i++) {
        if (used[i]) {
            printf(" %d(%d)", i, used[i]);
            distinct++;
        }
    }
    printf("  = %d distinct of 16\n", distinct);

    snprintf(path, sizeof(path), "%s/ramp-portrait-raster.ppm", dir);
    if (writeRaster(path)) return 2;
    snprintf(path, sizeof(path), "%s/ramp-portrait.ppm", dir);
    if (writePortrait(path)) return 2;

    printf("%s\n", failures ? "RESULT: FAIL" : "RESULT: PASS");
    return failures ? 1 : 0;
}
